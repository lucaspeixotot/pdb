## zeta/templates/zeta/Kconfig
```kconfig
menuconfig ZETA
    bool "Zeta"
    help
        This option enables Zeta support.


if ZETA

module = ZETA
module-str = zt
source "subsys/logging/Kconfig.template.log_config"

config ZETA_STORAGE
       bool "Enable zeta storage support"
       select FLASH
       select FLASH_PAGE_LAYOUT
       select FLASH_MAP
       select MPU_ALLOW_FLASH_WRITE
       select NVS  

config ZETA_FORWARDER
       bool "Enable the zeta forwarder thread"
       select BASE64

config ZETA_SERIAL_IPC
	   bool "Enable the  zeta IPC over serial"

endif # ZETA
```
